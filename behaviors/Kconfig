## behaviors/Kconfig
```kconfig
menuconfig ZMK_BEHAVIOR_TRACKPAD_TO_POS
    bool "Trackpad to position behavior"
    default y
    help
      Enable the trackpad-to-position behavior that raises position_state_changed
      events for a virtual key position.
```

## drivers/input/Kconfig
```kconfig
menuconfig INPUT_IQS9151
    bool "Azoteq IQS9151 driver"
    default y
    depends on GPIO
    depends on I2C
    depends on INPUT
    depends on DT_HAS_AZOTEQ_IQS9151_ENABLED
    help
      Enable the AZOTEQ IQS9151 trackpad driver.

if INPUT_IQS9151

config INPUT_IQS9151_LOG_LEVEL
    int "IQS9151 log level"
    range 0 4
    default INPUT_LOG_LEVEL if LOG
    default 0
    help
      Log level for the IQS9151 driver module.
      0: none, 1: err, 2: wrn, 3: inf, 4: dbg.
      Defaults to INPUT_LOG_LEVEL to follow input subsystem policy.

config INPUT_IQS9151_INIT_PRIORITY
    int "IQS9151 init priority"
    default 80
    help
      Define the initialization priority for the IQS9151 driver.

choice INPUT_IQS9151_ROTATE
    prompt "IQS9151 rotate"
    default INPUT_IQS9151_ROTATE_0
    help
      Rotate the trackpad coordinate system (0/90/180/270).
      Currently not applied by the driver.

config INPUT_IQS9151_ROTATE_0
    bool "0"

config INPUT_IQS9151_ROTATE_90
    bool "90"

config INPUT_IQS9151_ROTATE_180
    bool "180"

config INPUT_IQS9151_ROTATE_270
    bool "270"
endchoice

config INPUT_IQS9151_RESOLUTION_X
    int "IQS9151 X resolution"
    range 0 65535
    default 2457
    help
      X Resolution (0x11E6).
      Currently not applied by the driver.

config INPUT_IQS9151_RESOLUTION_Y
    int "IQS9151 Y resolution"
    range 0 65535
    default 3072
    help
      Y Resolution (0x11E8).
      Currently not applied by the driver.

config INPUT_IQS9151_ATI_TARGETCOUNT
    int "IQS9151 ATI target count"
    range 0 1000
    default 400
    help
      Trackpad ATI Target (0x119A).
      Limited to 0-1000 to avoid unstable behavior.
      Currently not applied by the driver.

config INPUT_IQS9151_DYNAMIC_FILTER_BOTTOM_SPEED
    int "IQS9151 dynamic filter bottom speed"
    range 0 65535
    default 20
    help
      XY Dynamic Filter Bottom Speed (0x11EA).
      Currently not applied by the driver.

config INPUT_IQS9151_DYNAMIC_FILTER_TOP_SPEED
    int "IQS9151 dynamic filter top speed"
    range 0 65535
    default 511
    help
      XY Dynamic Filter Top Speed (0x11EC).
      Currently not applied by the driver.

config INPUT_IQS9151_DYNAMIC_FILTER_BOTTOM_BETA
    int "IQS9151 dynamic filter bottom beta"
    range 0 255
    default 10
    help
      XY Dynamic Filter Bottom Beta (0x11EE).
      Currently not applied by the driver.

config INPUT_IQS9151_1F_TAP_ENABLE
    bool "IQS9151 single-finger tap enable"
    default y
    help
      Enable single-finger tap detection in the driver.

config INPUT_IQS9151_1F_TAP_MAX_MS
    int "IQS9151 single-finger tap max time (ms)"
    range 1 1000
    default 150
    help
      Maximum down duration for 1F tap detection (driver-side).

config INPUT_IQS9151_1F_TAP_MOVE
    int "IQS9151 single-finger tap move threshold"
    range 1 1000
    default 25
    help
      Maximum accumulated movement for 1F tap detection (driver-side).

config INPUT_IQS9151_1F_PRESSHOLD_ENABLE
    bool "IQS9151 single-finger press/hold enable"
    default y
    help
      Enable single-finger press/hold detection in the driver.

config INPUT_IQS9151_1F_HOLD_MIN_MS
    int "IQS9151 single-finger hold minimum time (ms)"
    range 1 3000
    default 200
    help
      Minimum down duration before 1F hold is considered (driver-side).

config INPUT_IQS9151_CURSOR_INERTIA_ENABLE
    bool "IQS9151 cursor inertia enable"
    default y
    help
      Enable cursor inertia (driver-side).

config INPUT_IQS9151_CURSOR_INERTIA_DECAY
    int "IQS9151 cursor inertia decay"
    range 0 1000
    default 970
    help
      Cursor inertia decay (driver-side).

config INPUT_IQS9151_2F_TAP_ENABLE
    bool "IQS9151 two-finger tap enable"
    default y
    help
      Enable two-finger tap detection in the driver.

config INPUT_IQS9151_2F_TAP_MAX_MS
    int "IQS9151 two-finger tap max time (ms)"
    range 1 1000
    default 150
    help
      Maximum down duration for 2F tap detection (driver-side).

config INPUT_IQS9151_2F_TAP_MOVE
    int "IQS9151 two-finger tap move threshold"
    range 1 1000
    default 30
    help
      Maximum centroid/distance movement for 2F tap detection (driver-side).

config INPUT_IQS9151_2F_PRESSHOLD_ENABLE
    bool "IQS9151 two-finger press/hold enable"
    default y
    help
      Enable two-finger press/hold detection in the driver.

config INPUT_IQS9151_2F_HOLD_MIN_MS
    int "IQS9151 two-finger hold minimum time (ms)"
    range 1 3000
    default 200
    help
      Minimum down duration before 2F hold is considered (driver-side).

config INPUT_IQS9151_SCROLL_Y_ENABLE
    bool "IQS9151 vertical scroll enable"
    default y
    help
      Enable driver-side vertical two-finger scroll.

config INPUT_IQS9151_SCROLL_X_ENABLE
    bool "IQS9151 horizontal scroll enable"
    default y
    help
      Enable driver-side horizontal two-finger scroll.

config INPUT_IQS9151_2F_SCROLL_START_MOVE
    int "IQS9151 two-finger scroll start threshold"
    range 1 2000
    default 50
    help
      Movement threshold to start 2F scroll mode (driver-side).

config INPUT_IQS9151_SCROLL_INERTIA_ENABLE
    bool "IQS9151 scroll inertia enable"
    default y
    help
      Enable scroll inertia (driver-side).

config INPUT_IQS9151_SCROLL_INERTIA_DECAY
    int "IQS9151 scroll inertia decay"
    range 0 1000
    default 985
    help
      Scroll inertia decay (driver-side).

config INPUT_IQS9151_2F_PINCH_ENABLE
    bool "IQS9151 two-finger pinch enable"
    default y
    help
      Enable driver-side two-finger pinch detection.

config INPUT_IQS9151_2F_PINCH_START_DISTANCE
    int "IQS9151 two-finger pinch start threshold"
    range 1 2000
    default 80
    help
      Distance-delta threshold to start 2F pinch mode (driver-side).

config INPUT_IQS9151_2F_PINCH_WHEEL_GAIN_X10
    int "IQS9151 two-finger pinch wheel gain (x10)"
    range 1 100
    default 40
    help
      Gain for 2F pinch REL_WHEEL output inside the driver.
      10 = 1.0x, 20 = 2.0x, 5 = 0.5x.

config INPUT_IQS9151_3F_TAP_ENABLE
    bool "IQS9151 three-finger tap enable"
    default y
    help
      Enable three-finger tap (driver-side).

config INPUT_IQS9151_3F_TAP_MAX_MS
    int "IQS9151 three-finger tap max time (ms)"
    range 1 1000
    default 180
    help
      Maximum down duration for 3F tap detection (driver-side).

config INPUT_IQS9151_3F_TAP_MOVE
    int "IQS9151 three-finger tap move threshold"
    range 1 1000
    default 30
    help
      Maximum finger1 tracked movement for 3F tap detection (driver-side).

config INPUT_IQS9151_3F_PRESSHOLD_ENABLE
    bool "IQS9151 three-finger press/hold enable"
    default y
    help
      Enable three-finger press/hold detection in the driver.

config INPUT_IQS9151_3F_HOLD_MIN_MS
    int "IQS9151 three-finger hold minimum time (ms)"
    range 1 3000
    default 200
    help
      Minimum down duration before 3F hold is considered (driver-side).

config INPUT_IQS9151_3F_SWIPE_THRESHOLD
    int "IQS9151 three-finger swipe threshold"
    range 0 1000
    default 300
    help
      Three-finger swipe threshold (driver-side).

config INPUT_IQS9151_TEST
    bool "IQS9151 test hooks"
    depends on ZTEST
    default n
    help
      Expose IQS9151 internal test APIs and event hooks for ZTEST.

endif
```

## drivers/input/Kconfig.iqs9151
```kconfig
config IQS9151_INPUT
    bool "IQS9151 input driver"
    depends on IQS9151
    help
      Input driver for the IQS9151 device.
```

## dts/bindings/behavior/zmk,behavior-zip-dynamic-scale.yaml
```yaml
description: Dynamic scale adjust behavior

compatible: "zmk,behavior-zip-dynamic-scale"

properties:
  display-name:
    type: string

  label:
    type: string
    required: false
    deprecated: true

  "#binding-cells":
    type: int
    required: true
    const: 1

binding-cells:
  - param1
```

## dts/bindings/input/azoteq,iqs9151.yaml
```yaml
description: |
  Azoteq IQS9151 capacitive touch controller.

  The driver configures the controller for event-mode communication and uses the
  interrupt line for data-ready signaling.

compatible: "azoteq,iqs9151"

include: i2c-device.yaml

properties:
  irq-gpios:
    type: phandle-array
    required: true
    description: |
      Interrupt GPIO for IQS9151.

  reset-gpios:
    type: phandle-array
    description: Reset pin

  enable-gpios:
    type: phandle-array
    description: Power enable pin

  vdd-supply:
    type: phandle
    description: VDD regulator

  vreg-supply:
    type: phandle
    description: VREG regulator
```

## dts/bindings/input_processors/zmk,input-processor-dynamic-scaler.yaml
```yaml
# Copyright (c) 2026
# SPDX-License-Identifier: MIT

description: Input processor for applying a dynamic scale factor

compatible: "zmk,input-processor-dynamic-scaler"

include: ip_zero_param.yaml

properties:
  type:
    type: int
    required: true
  codes:
    type: array
    required: true
```

## zephyr/Kconfig
```kconfig
menu "IQS9151 Driver"

config IQS9151
    bool "Azoteq IQS9151 touch controller"
    depends on I2C
    depends on GPIO
    default y
    help
      Enable driver support for the Azoteq IQS9151 device.

endmenu
```
